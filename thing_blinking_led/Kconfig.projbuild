## thing_blinking_led/Kconfig.projbuild
```kconfig
menu "LED config"
		
config LED_GPIO
	int "GPIO number for led ON/OFF"
	range 0 34
	default 26
	help
		GPIO number for blinking led.
		
		Some GPIOs are used for other purposes (flash connections, etc.) and cannot be used.

		GPIOs 35-39 are input-only so cannot be used to drive the led.

endmenu
```

## thing_button/Kconfig.projbuild
```kconfig
menu "Button config"

config BUTTON_GPIO
	int "GPIO number for button"
	range 0 34
	default 22
	help
		GPIO number for button.
		
		Some GPIOs are used for other purposes (flash connections, etc.) and cannot be used.

		GPIOs 35-39 are input-only.

endmenu
```

## thing_ws2812_controller/Kconfig.projbuild
```kconfig
menu "RGB Controller"

config PIN_WS2812_DATA
    int "WS2812 Data GPIO number"
	range 0 34
	default 25
	help
		GPIO number (IOxx) to send RGB data via SPI interface.

		Some GPIOs are used for other purposes (flash connections, etc.) and cannot be used.

		GPIOs 35-39 are input-only so cannot be used to drive the One Wire Bus.
		
endmenu
```

## web_thing_server/Kconfig.projbuild
```kconfig
menu "Web Thing Server"

config RESET_GPIO
    int "NVS Reset GPIO number"
	range 0 34
	default 27
	help
		GPIO number (IOxx) to access One Wire Bus.

		Some GPIOs are used for other purposes (flash connections, etc.) and cannot be used.

		GPIOs 35-39 are input-only so cannot be used to drive the One Wire Bus.

endmenu
```
